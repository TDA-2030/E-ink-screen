## firmware/components/epd2in13/Kconfig
```kconfig
menu "Eink Setting"
    choice EPD_SCREEN_SELECT
        bool "Select Epaper Screen"
        default EPD_SCREEN_2IN13
        help
            Select Epaper Screen.
    
        config EPD_SCREEN_2IN13
            bool "2in13"
        config EPD_SCREEN_2IN13_GOOD_DISPLAY
            bool "2in13 good display"
    endchoice

    config EDPIO_RST_PIN
        int "RESET PIN"
        default 5
        help
            Define gpio number of reset.

    config EDPIO_DC_PIN
        int "D/C PIN"
        default 16
        help
            Define gpio number of d/c.

    config EDPIO_CS_PIN
        int "CS PIN"
        default 21
        help
            Define gpio number of cs.

    config EDPIO_BUSY_PIN
        int "BUSY PIN"
        default 17
        help
            Define gpio number of busy.

    config EDPIO_MOSI_PIN
        int "MOSI PIN"
        default 18
        help
            Define gpio number of mosi.

    config EDPIO_SCLK_PIN
        int "SCLK PIN"
        default 19
        help
            Define gpio number of sclk.
endmenu
    
```

## firmware/components/webpage_config/Kconfig
```kconfig
menu "Captive Portal"
    config WEB_DNS_SUPPORT
        bool "Enable DNS support"
        default y 
        help
                Enable this to allows use domain name to access http serve

    config WEB_USE_GZIP_COMPRESSION
            bool "Compress webpages with gzip"
            default n
            help
                    Compress webpages files with the gzip compressor. Needs gzip installed.


    config WEB_SSL_SUPPORT
            #bool "Enable SSL support"  #Disabled by for now.
            bool
            default n
            help
                    SSL connections require ~32k of ram each.

                    Enabling this allows the server to be placed into ssl mode.

                    SSL servers require certificates. Steps to use:
                    - Place a 'cacert.pem' and 'prvtkey.pem' files in your app directory.

                    - To create self certified certificates:
                            $ openssl req -sha256 -newkey rsa:4096 -nodes -keyout key.pem -x509 -days 365 -out certificate.pem

                    - Create a 'component.mk' file in your app directory and add these lines to it:
                            COMPONENT_EMBED_TXTFILES := cacert.pem
                            COMPONENT_EMBED_TXTFILES += prvtkey.pem


    
    
endmenu
```
